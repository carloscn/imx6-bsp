## bsp/configs/imx6ull_fit_image.its
```
/dts-v1/;

/ {
    description = "U-Boot fitImage for imx6ull kernel";
    #address-cells = <1>;

    images {
        kernel {
            description = "Linux Kernel";
            data = /incbin/("../linux-imx/arch/arm/boot/zImage");
            type = "kernel";
            arch = "arm";
            os = "linux";
			compression = "none";
			load = <0x81000000>;
			entry = <0x81000000>;
            hash {
                algo = "sha1";
            };
        };
        fdt {
            description = "Flattened Device Tree blob";
			data = /incbin/("../linux-imx/arch/arm/boot/dts/imx6ull-14x14-evk.dtb");
            type = "flat_dt";
            arch = "arm";
            compression = "none";
            hash {
                algo = "sha1";
            };
        };
    };
    configurations {
        default = "conf";
        conf {
            description = "Boot Linux kernel with FDT blob!";
            kernel = "kernel";
            fdt = "fdt";
            hash {
                algo = "sha1";
            };
        };
    };
};
```
